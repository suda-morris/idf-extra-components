## cherryecat/Kconfig
```kconfig
menu "CherryECAT Configuration"

    # Hidden: the netdev port receives EtherCAT frames through the L2 TAP
    # interface (esp_vfs_l2tap); selecting it also enables the esp_eth
    # sublayer IO driver provider needed for the descriptor binding.
    config CHERRYECAT_USE_L2TAP
        bool
        default y
        select ESP_NETIF_L2_TAP

    config CHERRYECAT_CMD_ENABLE
        bool "Enable ethercat command line tool"
        default y
        help
            Compile the vendored IgH style "ethercat" command (src/ec_cmd.c) and
            register it with esp_console through esp_cherryecat_console_register().

    config CHERRYECAT_PRINTF_COLOR_ENABLE
        bool "Enable colored log output"
        default y

    config CHERRYECAT_ASSERT_DISABLE
        bool "Disable internal assertions"
        default n

    config CHERRYECAT_PDO_MULTI_DOMAIN
        bool "Use one LRW datagram per slave (multi domain)"
        default n
        help
            By default all slaves share one LRW datagram. When enabled, each
            slave gets its own LRW datagram at the cost of more frames per cycle.

    config CHERRYECAT_MAX_NETDEVS
        int "Maximum number of network devices"
        range 1 2
        default 1
        help
            Number of EtherCAT network devices. Backup redundancy is not
            implemented upstream yet, one netdev is the supported setup.

    menu "Resource limits"

        config CHERRYECAT_MAX_PDO_BUFSIZE
            int "PDO buffer size per netdev [bytes]"
            range 1 2048
            default 2048

        config CHERRYECAT_PER_SM_MAX_PDOS
            int "Maximum number of PDOs per sync manager"
            range 1 16
            default 3

        config CHERRYECAT_PER_PDO_MAX_PDO_ENTRIES
            int "Maximum number of entries per PDO"
            range 1 64
            default 8

    endmenu

    menu "Threads and timing"

        config CHERRYECAT_NONPERIOD_PRIO
            int "Non-periodic thread priority (smaller means higher priority)"
            range 0 23
            default 20

        config CHERRYECAT_NONPERIOD_STACKSIZE
            int "Non-periodic thread stack size [bytes]"
            range 1536 16384
            default 3072

        config CHERRYECAT_NONPERIOD_WAITERS
            int "Non-periodic datagram waiter count"
            range 1 64
            default 20

        config CHERRYECAT_SCAN_PRIO
            int "Bus scan thread priority (smaller means higher priority)"
            range 0 23
            default 21

        config CHERRYECAT_SCAN_STACKSIZE
            int "Bus scan thread stack size [bytes]"
            range 1536 16384
            default 3072

        config CHERRYECAT_SCAN_INTERVAL_MS
            int "Bus scan interval [ms]"
            range 10 10000
            default 100

        config CHERRYECAT_TASK_CORE
            int "Core for the stack threads (scan, non-periodic)"
            range 0 1
            default 0
            help
                The upstream stack was designed for single-core targets: the
                periodic process ran in a timer ISR, so its unlocked datagram
                queue operations relied on interrupt disabling for mutual
                exclusion. On ESP-IDF the periodic process runs in the PDO
                cycle task, so the stack threads and the cycle task must all
                run on the same core to keep that exclusion. Keep this equal
                to CHERRYECAT_CYCLE_TASK_CORE.

        config CHERRYECAT_CYCLE_TASK_PRIORITY
            int "PDO cycle task priority (FreeRTOS, larger means higher priority)"
            range 1 24
            default 22
            help
                The task running the periodic PDO process (woken by the gptimer
                alarm). Keep it above most application tasks for a low cycle
                jitter; it must stay below the esp_timer task and Ethernet
                driver priorities so driver processing is never starved.

        config CHERRYECAT_CYCLE_TASK_STACKSIZE
            int "PDO cycle task stack size [bytes]"
            range 2048 16384
            default 4096

        config CHERRYECAT_CYCLE_TASK_CORE
            int "PDO cycle task core affinity"
            range 0 1
            default 0
            help
                Must stay equal to CHERRYECAT_TASK_CORE: the cycle task and
                the stack threads share unlocked data structures that are
                only safe when they never run concurrently (same core).

    endmenu

    menu "Debugging"

        config CHERRYECAT_DBG_LEVEL
            int "Master debug level (0 error, 1 warning, 2 info, 3 log)"
            range 0 3
            default 2

        config CHERRYECAT_SLAVE_DBG_LEVEL
            int "Slave debug level (0 error, 1 warning, 2 info, 3 log)"
            range 0 3
            default 2

    endmenu

    menu "Ethernet port buffers"

        config CHERRYECAT_TXBUF_COUNT
            int "Number of staged TX frame buffers per netdev"
            range 1 20
            default 10

    endmenu

endmenu
```

## esp_lcd_sim/Kconfig
```kconfig
menu "ESP LCD Sim"

    config ESP_LCD_SIM_CONSOLE
        bool "esp_console command interface"
        default n
        help
            Enable esp_lcd_sim_console_register(), which registers a set of
            esp_console commands (touch, reset, frame, wait, quit) that drive a
            simulated panel from a command line, so a host test can script touch
            input and frame export. This pulls in the esp_console component.
            When disabled, esp_lcd_sim_console_register() returns
            ESP_ERR_NOT_SUPPORTED and the panel itself is unaffected.

endmenu
```

## xymodem/examples/xymodem_event/main/Kconfig.projbuild
```kconfig
menu "XYMODEM Event Example"
    config EXAMPLE_UART_PORT_NUM
        int "UART port number"
        default 0
    config EXAMPLE_UART_TX_GPIO
        int "UART TX GPIO"
        default 4
    config EXAMPLE_UART_RX_GPIO
        int "UART RX GPIO"
        default 5
    config EXAMPLE_UART_BAUD_RATE
        int "UART baud rate"
        default 115200
endmenu
```

## xymodem/examples/xymodem_ota/main/Kconfig.projbuild
```kconfig
menu "XYMODEM OTA Example Configuration"

    config EXAMPLE_UART_PORT_NUM
        int "UART port number"
        default 0
        help
            The UART port attached to the UHCI DMA controller.

    config EXAMPLE_UART_TX_GPIO
        int "UART TX GPIO"
        default 11

    config EXAMPLE_UART_RX_GPIO
        int "UART RX GPIO"
        default 12

    config EXAMPLE_UART_BAUD_RATE
        int "UART baud rate"
        default 115200

endmenu
```

## xymodem/test_apps/main/Kconfig.projbuild
```kconfig
menu "XYMODEM Test"

    config XYMODEM_TEST_UART_BAUD
        int "UART baud rate"
        default 115200
        range 9600 2000000
        help
            Baud rate used by both UART ports in the loopback test.

    config XYMODEM_TEST_SENDER_UART
        int "Sender UART port number"
        default 0
        range 0 5
        help
            UART port used by the sender. The console lives on USB Serial/JTAG,
            so UART0 and UART1 are both free for the loopback pair.

    config XYMODEM_TEST_RECEIVER_UART
        int "Receiver UART port number"
        default 1
        range 0 5
        help
            UART port used by the receiver. Must be different from the sender
            port. Needs a target with two HP UART controllers (C3/C6/P4/...).

    config XYMODEM_TEST_GPIO_A
        int "GPIO for sender TX / receiver RX"
        default 4
        range 0 63
        help
            This GPIO is driven by the sender UART TX and sampled by the receiver UART RX
            through the GPIO matrix. No external jumper is required.

    config XYMODEM_TEST_GPIO_B
        int "GPIO for receiver TX / sender RX"
        default 5
        range 0 63
        help
            This GPIO is driven by the receiver UART TX and sampled by the sender UART RX
            through the GPIO matrix. No external jumper is required.

endmenu
```
