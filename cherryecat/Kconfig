## cherryecat/Kconfig
```kconfig
menu "CherryECAT Configuration"

    # Hidden: the netdev port receives EtherCAT frames through the L2 TAP
    # interface (esp_vfs_l2tap); selecting it also enables the esp_eth
    # sublayer IO driver provider needed for the descriptor binding.
    config CHERRYECAT_USE_L2TAP
        bool
        default y
        select ESP_NETIF_L2_TAP

    config CHERRYECAT_CMD_ENABLE
        bool "Enable ethercat command line tool"
        default y
        help
            Compile the vendored IgH style "ethercat" command (src/ec_cmd.c) and
            register it with esp_console through esp_cherryecat_console_register().

    config CHERRYECAT_PRINTF_COLOR_ENABLE
        bool "Enable colored log output"
        default y

    config CHERRYECAT_ASSERT_DISABLE
        bool "Disable internal assertions"
        default n

    config CHERRYECAT_PDO_MULTI_DOMAIN
        bool "Use one LRW datagram per slave (multi domain)"
        default n
        help
            By default all slaves share one LRW datagram. When enabled, each
            slave gets its own LRW datagram at the cost of more frames per cycle.

    config CHERRYECAT_MAX_NETDEVS
        int "Maximum number of network devices"
        range 1 2
        default 1
        help
            Number of EtherCAT network devices. Backup redundancy is not
            implemented upstream yet, one netdev is the supported setup.

    menu "Resource limits"

        config CHERRYECAT_MAX_PDO_BUFSIZE
            int "PDO buffer size per netdev [bytes]"
            range 1 2048
            default 2048

        config CHERRYECAT_PER_SM_MAX_PDOS
            int "Maximum number of PDOs per sync manager"
            range 1 16
            default 3

        config CHERRYECAT_PER_PDO_MAX_PDO_ENTRIES
            int "Maximum number of entries per PDO"
            range 1 64
            default 8

    endmenu

    menu "Threads and timing"

        config CHERRYECAT_NONPERIOD_PRIO
            int "Non-periodic thread priority (smaller means higher priority)"
            range 0 23
            default 20

        config CHERRYECAT_NONPERIOD_STACKSIZE
            int "Non-periodic thread stack size [bytes]"
            range 1536 16384
            default 3072

        config CHERRYECAT_NONPERIOD_WAITERS
            int "Non-periodic datagram waiter count"
            range 1 64
            default 20

        config CHERRYECAT_SCAN_PRIO
            int "Bus scan thread priority (smaller means higher priority)"
            range 0 23
            default 21

        config CHERRYECAT_SCAN_STACKSIZE
            int "Bus scan thread stack size [bytes]"
            range 1536 16384
            default 3072

        config CHERRYECAT_SCAN_INTERVAL_MS
            int "Bus scan interval [ms]"
            range 10 10000
            default 100

        config CHERRYECAT_CYCLE_TASK_PRIORITY
            int "PDO cycle task priority (FreeRTOS, larger means higher priority)"
            range 1 24
            default 22
            help
                The task running the periodic PDO process (woken by the gptimer
                alarm). Keep it above most application tasks for a low cycle
                jitter; it must stay below the esp_timer task and Ethernet
                driver priorities so driver processing is never starved.

        config CHERRYECAT_CYCLE_TASK_STACKSIZE
            int "PDO cycle task stack size [bytes]"
            range 2048 16384
            default 4096

        config CHERRYECAT_CYCLE_TASK_CORE
            int "PDO cycle task core affinity (-1 for no affinity)"
            range -1 1
            default -1
            help
                Pin the PDO cycle task to a core to further reduce cycle jitter.
                -1 keeps the default scheduler affinity.

    endmenu

    menu "Debugging"

        config CHERRYECAT_DBG_LEVEL
            int "Master debug level (0 error, 1 warning, 2 info, 3 log)"
            range 0 3
            default 2

        config CHERRYECAT_SLAVE_DBG_LEVEL
            int "Slave debug level (0 error, 1 warning, 2 info, 3 log)"
            range 0 3
            default 2

    endmenu

    menu "Ethernet port buffers"

        config CHERRYECAT_TXBUF_COUNT
            int "Number of staged TX frame buffers per netdev"
            range 1 20
            default 10

    endmenu

endmenu
```

## esp_lcd_host/examples/lvgl_host_sdl/sdkconfig.defaults
```kconfig
CONFIG_IDF_TARGET="linux"

CONFIG_LV_COLOR_DEPTH_24=y
CONFIG_LV_FONT_MONTSERRAT_14=y

CONFIG_ESP_MAIN_TASK_STACK_SIZE=65536
```

## lz4/Kconfig
```kconfig
menu "LZ4 Configurations"

    config LZ4_USE_PSRAM
        bool "Prefer PSRAM for LZ4 internal allocations"
        depends on SPIRAM
        default n
        help
            Prefer PSRAM for LZ4's large library-internal heap allocations when
            available. Internal 8-bit RAM is used as a fallback when PSRAM is
            not initialized or cannot satisfy an allocation.

            Allocations of 32 KiB or more (HC workspaces, Frame scratch,
            lz4file buffers) prefer PSRAM. Smaller objects, including Block
            hash tables, prefer internal RAM: compression walks the hash table
            randomly, which is slower in PSRAM.

            Either class falls back to the other region when the preferred
            heap cannot satisfy the request.

    config LZ4_FAST_DEC_LOOP
        bool "Enable LZ4 fast decode loop"
        default n
        help
            Opt into the upstream fast-path decoder. Upstream enables it only
            for x86 and aarch64 builds and leaves it off for other targets
            including Xtensa and RISC-V; this option follows the same
            conservative default for ESP targets.

            Measured on an ESP32-C5 with this component's benchmark
            (compressible input): decompression +17% throughput at a cost of
            about 3 KiB of code size. Enable this option for decompression-
            heavy workloads such as compressed assets, logs, or network
            payloads.

    choice LZ4_BLOCK_HASH_TABLE_SIZE
        prompt "LZ4 Block API hash table size"
        default LZ4_BLOCK_HASH_TABLE_SIZE_16KB
        help
            Memory reserved from the heap by every Block compression state for
            its hash table. Smaller tables shrink the per-call allocation and
            can improve cache locality, at the cost of compression ratio.
            HC and Frame states are not affected.

            Do not place this state on a small FreeRTOS task stack.

        config LZ4_BLOCK_HASH_TABLE_SIZE_1KB
            bool "1 KiB"

        config LZ4_BLOCK_HASH_TABLE_SIZE_2KB
            bool "2 KiB"

        config LZ4_BLOCK_HASH_TABLE_SIZE_4KB
            bool "4 KiB"

        config LZ4_BLOCK_HASH_TABLE_SIZE_8KB
            bool "8 KiB"

        config LZ4_BLOCK_HASH_TABLE_SIZE_16KB
            bool "16 KiB (upstream default)"

    endchoice

endmenu
```

## lz4/test_apps/test_lz4/sdkconfig.defaults
```kconfig
# CONFIG_ESP_TASK_WDT_INIT is not set

CONFIG_FREERTOS_HZ=1000
CONFIG_PARTITION_TABLE_CUSTOM=y
CONFIG_PARTITION_TABLE_CUSTOM_FILENAME="partitions.csv"
```

## zlib/Kconfig
```kconfig
menu "zlib Configurations"

    config ZLIB_PREFER_PSRAM
        bool "Prefer PSRAM for zlib's own allocations"
        depends on SPIRAM
        default y
        help
            Route the memory zlib allocates for itself through heap_caps, so
            its large working buffers can live in PSRAM. Internal 8-bit RAM is
            used as a fallback when PSRAM is not initialized or cannot satisfy
            an allocation. Requests below 16 KiB keep preferring internal RAM.

            Without this option zlib calls malloc(). With
            CONFIG_SPIRAM_USE_CAPS_ALLOC, malloc() never returns PSRAM; with
            CONFIG_SPIRAM_USE_MALLOC, only requests above
            CONFIG_SPIRAM_MALLOC_ALWAYSINTERNAL do. Enabling this option is
            therefore the only way to move zlib's working buffers out of
            internal RAM in either configuration.

            The component's zcalloc()/zcfree() are compiled in either way; this
            option only selects which allocator they call.

            Only the allocator zlib uses for its own state and buffers is
            affected. The compression and decompression buffers an application
            passes in are its own, and are allocated by the application.

            A custom allocator installed in z_stream.zalloc/zfree always wins
            over this option, as zlib documents.

            PSRAM is slower than internal RAM, so compression and
            decompression run slower with this option enabled.

endmenu
```
